## conf/layer.conf
```bitbake
# We have a conf and classes directory, add to BBPATH
BBPATH .= ":${LAYERDIR}"

# We have recipes-* directories, add to BBFILES
BBFILES += "${LAYERDIR}/recipes-*/*/*.bb \
            ${LAYERDIR}/recipes-*/*/*.bbappend"

BBFILE_COLLECTIONS += "zybo-z7"
BBFILE_PATTERN_zybo-z7 = "^${LAYERDIR}/"
BBFILE_PRIORITY_zybo-z7 = "6"

LAYERDEPENDS_zybo-z7 = "core"
LAYERSERIES_COMPAT_zybo-z7 = " kirkstone"
```

## conf/machine/include/zynq7000.inc
```bitbake
require conf/machine/include/arm/armv7a/tune-cortexa9.inc

KERNEL_PROVIDER ?= "linux-zynq"
PREFERRED_PROVIDER_virtual/kernel ?= "${KERNEL_PROVIDER}"
# PREFERRED_PROVIDER_virtual/bootloader = "u-boot"
# Increase this everytime you change something in the kernel
MACHINE_KERNEL_PR = "r1"

KERNEL_IMAGETYPE = "zImage"

MACHINE_EXTRA_RRECOMMENDS = " kernel-modules"
MACHINE_ESSENTIAL_EXTRA_RDEPENDS = " kernel-module-jj-xlnx-frmbuf"
MACHINE_FEATURES = "kernel26"

# file system images required
IMAGE_FSTYPES ?= "tar.gz"
```

## conf/machine/zynq7000.conf
```bitbake
#@TYPE: Machine
#@NAME: zynq7000
#@DESCRIPTION: Machine configuration for the zynq7000" 

require conf/machine/include/zynq7000.inc

KMACHINE = "zynq7000"

# Default kernel devicetrees
KERNEL_DEVICETREE ?= "system-top.dtb"
SERIAL_CONSOLES ?= "115200;ttyPS0"
```
